## Documentation/devicetree/bindings/mmc/sdhci-atmel.txt
```
* Atmel SDHCI controller

This file documents the differences between the core properties in
Documentation/devicetree/bindings/mmc/mmc.txt and the properties used by the
sdhci-of-at91 driver.

Required properties:
- compatible:		Must be "atmel,sama5d2-sdhci" or "microchip,sam9x60-sdhci".
- clocks:		Phandlers to the clocks.
- clock-names:		Must be "hclock", "multclk", "baseclk" for
			"atmel,sama5d2-sdhci".
			Must be "hclock", "multclk" for "microchip,sam9x60-sdhci".

Optional properties:
- assigned-clocks:	The same with "multclk".
- assigned-clock-rates	The rate of "multclk" in order to not rely on the
			gck configuration set by previous components.


Examples:

sdmmc0: sdio-host@a0000000 {
	compatible = "atmel,sama5d2-sdhci";
	reg = <0xa0000000 0x300>;
	interrupts = <31 IRQ_TYPE_LEVEL_HIGH 0>;
	clocks = <&sdmmc0_hclk>, <&sdmmc0_gclk>, <&main>;
	clock-names = "hclock", "multclk", "baseclk";
	assigned-clocks = <&sdmmc0_gclk>;
	assigned-clock-rates = <480000000>;
};

sdmmc0: sdio-host@80000000 {
	compatible = "microchip,sam9x60-sdhci";
	reg = <0x80000000 0x300>;
	interrupts = <12 IRQ_TYPE_LEVEL_HIGH 0>;
	clocks = <&pmc PMC_TYPE_PERIPHERAL 12>, <&pmc PMC_TYPE_GCK 12>;
	clock-names = "hclock", "multclk";
	assigned-clocks = <&pmc PMC_TYPE_GCK 12>;
	assigned-clock-rates = <100000000>;
};
```

## Documentation/devicetree/bindings/net/dsa/ksz.txt
```
Microchip KSZ Series Ethernet switches
==================================

Required properties:

- compatible: For external switch chips, compatible string must be exactly one
  of the following:
  - "microchip,ksz9477"
  - "microchip,ksz9897"
  - "microchip,ksz9567"
  - "microchip,ksz9566"
  - "microchip,ksz9565"
  - "microchip,ksz8567"
  - "microchip,ksz8566"
  - "microchip,ksz8565"
  - "microchip,ksz9893"
  - "microchip,ksz9563"
  - "microchip,ksz8563"
  - "microchip,ksz8795"
  - "microchip,ksz8794"
  - "microchip,ksz8765"
  - "microchip,ksz8895"
  - "microchip,ksz8864"

See Documentation/devicetree/bindings/net/dsa/dsa.txt for a list of additional
required and optional properties.

Examples:

Ethernet switch connected via SPI to the host, CPU port wired to eth0:

	eth0: ethernet@10001000 {
		fixed-link {
			speed = <1000>;
			full-duplex;
		};
	};

	spi1: spi@f8008000 {
		cs-gpios = <&pioC 25 0>;
		id = <1>;

		ksz9477: ksz9477@0 {
			compatible = "microchip,ksz9477";
			reg = <0>;

			spi-max-frequency = <44000000>;
			spi-cpha;
			spi-cpol;

			ports {
				#address-cells = <1>;
				#size-cells = <0>;
				port@0 {
					reg = <0>;
					label = "lan1";
				};
				port@1 {
					reg = <1>;
					label = "lan2";
				};
				port@2 {
					reg = <2>;
					label = "lan3";
				};
				port@3 {
					reg = <3>;
					label = "lan4";
				};
				port@4 {
					reg = <4>;
					label = "lan5";
				};
				port@5 {
					reg = <5>;
					label = "cpu";
					ethernet = <&eth0>;
					fixed-link {
						speed = <1000>;
						full-duplex;
					};
				};
				port@6 {
					reg = <6>;
					label = "lan6";
					fixed-link {
						speed = <1000>;
						full-duplex;
					};
				};
			};
		};
		ksz8565: ksz8565@0 {
			compatible = "microchip,ksz8565";
			reg = <0>;

			spi-max-frequency = <44000000>;
			spi-cpha;
			spi-cpol;

			ports {
				#address-cells = <1>;
				#size-cells = <0>;
				port@0 {
					reg = <0>;
					label = "lan1";
				};
				port@1 {
					reg = <1>;
					label = "lan2";
				};
				port@2 {
					reg = <2>;
					label = "lan3";
				};
				port@3 {
					reg = <3>;
					label = "lan4";
				};
				port@4 {
					reg = <6>;
					label = "cpu";
					ethernet = <&eth0>;
					fixed-link {
						speed = <1000>;
						full-duplex;
					};
				};
			};
		};
		ksz8794: ksz8794@0 {
			compatible = "microchip,ksz8794";
			reg = <0>;

			spi-max-frequency = <30000000>;
			spi-cpha;
			spi-cpol;

			ports {
				#address-cells = <1>;
				#size-cells = <0>;
				port@0 {
					reg = <0>;
					label = "lan1";
				};
				port@1 {
					reg = <1>;
					label = "lan2";
				};
				port@2 {
					reg = <2>;
					label = "lan3";
				};
				port@3 {
					reg = <4>;
					label = "cpu";
					ethernet = <&eth0>;
					fixed-link {
						speed = <100>;
						full-duplex;
					};
				};
			};
		};
		ksz8864: ksz8864@0 {
			compatible = "microchip,ksz8864";
			reg = <0>;

			spi-max-frequency = <12000000>;
			spi-cpha;
			spi-cpol;

			ports {
				#address-cells = <1>;
				#size-cells = <0>;
				port@0 {
					reg = <1>;
					label = "lan1";
				};
				port@1 {
					reg = <2>;
					label = "lan2";
				};
				port@2 {
					reg = <3>;
					label = "lan3";
				};
				port@3 {
					reg = <4>;
					label = "cpu";
					ethernet = <&eth0>;
					fixed-link {
						speed = <100>;
						full-duplex;
					};
				};
			};
		};
	};
```

## Documentation/devicetree/bindings/net/wireless/mediatek,mt76.txt
```
* MediaTek mt76xx devices

This node provides properties for configuring the MediaTek mt76xx wireless
device. The node is expected to be specified as a child node of the PCI
controller to which the wireless chip is connected.

Optional properties:

- ieee80211-freq-limit: See ieee80211.txt
- mediatek,mtd-eeprom: Specify a MTD partition + offset containing EEPROM data

The driver is using of_get_mac_address API, so the MAC address can be as well
be set with corresponding optional properties defined in net/ethernet.txt.

Optional nodes:
- led: Properties for a connected LED
  Optional properties:
    - led-sources: See Documentation/devicetree/bindings/leds/common.txt

&pcie {
	pcie0 {
		wifi@0,0 {
			compatible = "mediatek,mt76";
			reg = <0x0000 0 0 0 0>;
			ieee80211-freq-limit = <5000000 6000000>;
			mediatek,mtd-eeprom = <&factory 0x8000>;

			led {
				led-sources = <2>;
			};
		};
	};
};
```

## Documentation/devicetree/bindings/watchdog/sam9x60-wdt.txt
```
* Microchip SAM9X60 Watchdog Timer (WDT) Controller

Required properties:
- compatible: "microchip,sam9x60-wdt"
- reg: base physical address and length of memory mapped region.

Optional properties:
- timeout-sec: watchdog timeout value (in seconds).
- interrupts: interrupt number to the CPU.
- atmel,watchdog-type: should be "hardware" or "software".
	"hardware": enable watchdog fault reset. A watchdog fault triggers
		    watchdog reset.
	"software": enable watchdog fault interrupt. A watchdog fault asserts
		    watchdog interrupt.
- atmel,idle-halt: present if you want to stop the watchdog when the CPU is
		   in idle state.
	CAUTION: This property should be used with care, it actually makes the
	watchdog not counting when the CPU is in idle state, therefore the
	watchdog reset time depends on mean CPU usage and will not reset at all
	if the CPU stop working while it is in idle state, which is probably
	not what you want.
- atmel,dbg-halt: present if you want to stop the watchdog when the CPU is
		  in debug state.

Example:
	watchdog@ffffff80 {
		compatible = "microchip,sam9x60-wdt";
		reg = <0xffffff80 0x24>;
		interrupts = <1 IRQ_TYPE_LEVEL_HIGH 5>;
		timeout-sec = <10>;
		atmel,watchdog-type = "hardware";
		atmel,dbg-halt;
		atmel,idle-halt;
	};
```
